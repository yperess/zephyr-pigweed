## app/boards/arm64/renode_cortex_a53/Kconfig.board
```kconfig
config BOARD_RENODE_CORTEX_A53
	bool "Cortex-A53 Emulation (RENODE)"
	depends on SOC_QEMU_CORTEX_A53
	select ARM64
```

## app/boards/arm64/renode_cortex_a53/Kconfig.defconfig
```kconfig
if BOARD_RENODE_CORTEX_A53

config BUILD_OUTPUT_BIN
	default y

config BOARD
	default "renode_cortex_a53"

config MAX_THREAD_BYTES
	default 3

choice ARM64_PA_BITS
	default ARM64_PA_BITS_40 if PCIE
endchoice

endif # BOARD_RENODE_CORTEX_A53
```

## app/testcase.yaml
```yaml
# Copyright (c) 2024 Google LLC
# SPDX-License-Identifier: Apache-2.0

tests:
  app.hello:
    timeout: 60
    platform_allow:
      - native_sim
      - qemu_riscv64
      - qemu_cortex_a53
#      - renode_cortex_a53
#      - hifive_unleashed
    harness: gtest
    extra_configs:
      - CONFIG_PIGWEED_LOG_ZEPHYR=y
      - CONFIG_TEST=y
#  app.hello.robot:
#    harness: robot
#    harness_config:
#      robot_test_path: app.robot
#    platform_allow:
#      - renode_cortex_a53
#      - hifive_unleashed
#
```

## boards/antmicro/renode_cortex_a53/Kconfig.renode_cortex_a53
```kconfig
# Copyright (c) 2024 Google LLC, Antmicro
# SPDX-License-Identifier: Apache-2.0

config BOARD_RENODE_CORTEX_A53
	bool "Cortex-A53 Emulation (RENODE)"
	select SOC_QEMU_CORTEX_A53
	select ARM64
```

## boards/antmicro/renode_cortex_a53/board.yml
```yaml
#
board:
  name: renode_cortex_a53
  vendor: antmicro
  socs:
    - name: qemu_cortex_a53
```

## boards/antmicro/renode_cortex_a53/renode_cortex_a53_defconfig
```kconfig
# Copyright (c) 2024 Google LLC, Antmicro
# SPDX-License-Identifier: Apache-2.0

#CONFIG_SOC_QEMU_CORTEX_A53=y
CONFIG_BOARD_RENODE_CORTEX_A53=y
CONFIG_ARM_ARCH_TIMER=y

# Cache management
CONFIG_CACHE_MANAGEMENT=y

# Enable UART driver
CONFIG_SERIAL=y

# Enable console
CONFIG_CONSOLE=y
CONFIG_UART_CONSOLE=y

# Enable serial port
CONFIG_UART_INTERRUPT_DRIVEN=y
```

## lib/Kconfig
```kconfig
# Copyright (c) 2024 Google LLC
# SPDX-License-Identifier: Apache-2.0

config APP_TRACK_TITLE_MAX_LEN
  int "Maximum length of a song Track's title string"
  default 48

config APP_TRACK_ARTIST_NAME_MAX_LEN
  int "Maximum length of a song Track's artist name"
  default 48
```

## manifest/west.yml
```yaml
# Copyright (c) 2024 Google LLC
# SPDX-License-Identifier: Apache-2.0

manifest:
  projects:
    - import: false
      name: pigweed
      path: third_party/pigweed
      remote: pigweed
      revision: main
    - import: true
      name: zephyr
      path: third_party/zephyr
      remote: zephyr
      revision: main
  remotes:
    - name: pigweed
      url-base: git@github.com:google
    - name: zephyr
      url-base: git@github.com:zephyrproject-rtos
```
